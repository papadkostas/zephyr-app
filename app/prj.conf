## CMakeLists.txt
```
#-------------------------------------------------------------------------------
# Zephyr Example Application
#
# Copyright (c) 2021 Nordic Semiconductor ASA
# SPDX-License-Identifier: Apache-2.0

cmake_minimum_required(VERSION 3.13.1)
find_package(Zephyr REQUIRED HINTS $ENV{ZEPHYR_BASE})

project(app LANGUAGES C)

target_sources(app PRIVATE src/main.c)

include_directories(src/ui)

FILE(GLOB ui_sources src/ui/*.c)
target_sources(app PRIVATE ${ui_sources})
```

## sample.yaml
```
# This file is provided so that the application can be compiled using Twister,
# the Zephyr testing tool. In this file, multiple combinations can be specified,
# so that you can easily test all of them locally or in CI.
sample:
  description: Zephyr application
  name: Zephyr UI application 
common:
  build_only: true
  integration_platforms:
    - custom_l432kc
tests:
  app.default: {}
  app.debug:
    extra_overlay_confs:
      - debug.conf
```

## prj.conf
```kconfig
# Copyright (c) 2021 Nordic Semiconductor ASA
# SPDX-License-Identifier: Apache-2.0
#
# This file contains selected Kconfig options for the application.

CONFIG_MAIN_STACK_SIZE=2048

CONFIG_LOG=y
#CONFIG_LOG_DEFAULT_LEVEL=3

CONFIG_SHELL=y

CONFIG_DISPLAY=y
#CONFIG_DISPLAY_LOG_LEVEL_DBG=y
CONFIG_LOG=y
CONFIG_APP_LOG_LEVEL_DBG=y

CONFIG_INPUT=y
CONFIG_INPUT_LOG_LEVEL_DBG=y

CONFIG_LVGL=y
CONFIG_LV_Z_MEM_POOL_SIZE=16384
CONFIG_LV_Z_SHELL=y
CONFIG_LV_USE_LABEL=y
CONFIG_LV_USE_BTN=y
# CONFIG_LV_USE_MONKEY=y
CONFIG_LV_FONT_MONTSERRAT_12=y

# CONFIG_LV_USE_LOG=y
# CONFIG_LV_LOG_LEVEL_INFO=y
# CONFIG_LV_LOG_LEVEL_TRACE=y
# CONFIG_LV_LOG_LEVEL=T
```

## src/main.c
```c
/*
 * Copyright (c) 2018 Jan Van Winkel <jan.van_winkel@dxplore.eu>
 *
 * SPDX-License-Identifier: Apache-2.0
 */

#include <zephyr/device.h>
#include <zephyr/devicetree.h>
#include <zephyr/drivers/display.h>
#include <zephyr/drivers/gpio.h>
#include <lvgl.h>
#include <stdio.h>
#include <string.h>
#include <zephyr/kernel.h>
#include <lvgl_input_device.h>
#include <zephyr/logging/log.h>

#include "main_screen.h"

LOG_MODULE_REGISTER(main, CONFIG_APP_LOG_LEVEL);

static uint32_t count;

static void lv_btn_click_callback(lv_event_t *e)
{
	ARG_UNUSED(e);
	LOG_INF("button pressed");
	count = 0;
}

int main(void)
{
	const struct device *display_dev;
	display_dev = DEVICE_DT_GET(DT_CHOSEN(zephyr_display));
	if (!device_is_ready(display_dev)) {
		LOG_ERR("Device not ready, aborting test");
		return 0;
	}

	lv_task_handler();
	
	display_blanking_off(display_dev);
	
	LOG_INF("App started!");
	
	main_screen_create(lv_scr_act());

	while (1) {
		lv_task_handler();
		k_sleep(K_MSEC(10));
	}
}
```
