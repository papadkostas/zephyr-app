## boards/arm/custom_l432kc/Kconfig.board
```kconfig
# SPDX-License-Identifier: Apache-2.0

config BOARD_CUSTOM_L432KC
	bool "Nucleo L432KC Custom Board"
	depends on SOC_STM32L432XX
```

## boards/arm/custom_l432kc/Kconfig.defconfig
```kconfig
# SPDX-License-Identifier: Apache-2.0

if BOARD_CUSTOM_L432KC

config BOARD
	default "custom_l432kc"

if DISPLAY

config SPI_STM32_INTERRUPT
	default y
	depends on SPI

config ILI9340
	default y

config INPUT
	default y if LVGL

if INPUT

config INPUT_XPT2046
	default y

endif # INPUT

if LVGL

config LV_Z_VDB_SIZE
	default 16

config LV_Z_BITS_PER_PIXEL
	default 16

choice LV_COLOR_DEPTH
	default LV_COLOR_DEPTH_16
endchoice

config LV_COLOR_16_SWAP
	default y

endif # LVGL	

endif # DISPLAY

endif # BOARD_NUCLEO_L432KC
```

## west.yml
```yaml
# Copyright (c) 2021 Nordic Semiconductor ASA
# SPDX-License-Identifier: Apache-2.0

manifest:
  self:
    west-commands: scripts/west-commands.yml

  remotes:
    - name: zephyrproject-rtos
      url-base: https://github.com/papadkostas

  projects:
    - name: zephyr
      remote: zephyrproject-rtos
      revision: ili9341_backlight
      import:
        # By using name-allowlist we can clone only the modules that are
        # strictly needed by the application.
        name-allowlist:
          - cmsis      # required by the ARM port
          - hal_stm32  # required by the nucleo_f302r8 board (STM32 based)
          - lvgl
```
